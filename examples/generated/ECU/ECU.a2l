ASAP2_VERSION 1 71
/begin PROJECT ECU "Generated by Nervus 0.1.0.dev0"
/begin MODULE ECU "Model ECU"
/begin MOD_COMMON "" BYTE_ORDER MSB_LAST ALIGNMENT_FLOAT64_IEEE 8 /end MOD_COMMON
/begin COMPU_METHOD CM_IDENTICAL "identity" IDENTICAL "%12.6" "" /end COMPU_METHOD
/begin RECORD_LAYOUT RL_FLOAT64 FNC_VALUES 1 FLOAT64_IEEE ROW_DIR DIRECT /end RECORD_LAYOUT
/begin COMPU_METHOD CM____ "unit %/°" IDENTICAL "%12.6" "%/°" /end COMPU_METHOD
/begin CHARACTERISTIC ECU_P.Kp "Proportional gain" VALUE 0x0 /* @ECU_P+0 */ RL_FLOAT64 0 CM____ 0.0 1e+12 /end CHARACTERISTIC
/begin COMPU_METHOD CM______s_ "unit %/(°·s)" IDENTICAL "%12.6" "%/(°·s)" /end COMPU_METHOD
/begin CHARACTERISTIC ECU_P.Ki "Integral gain" VALUE 0x0 /* @ECU_P+8 */ RL_FLOAT64 0 CM______s_ 0.0 1e+12 /end CHARACTERISTIC
/begin CHARACTERISTIC ECU_P.throttle_pi_D "throttle_pi: D" VALUE 0x0 /* @ECU_P+16 */ RL_FLOAT64 0 CM_IDENTICAL -1e+12 1e+12 /end CHARACTERISTIC
/begin CHARACTERISTIC ECU_P.throttle_pi_N "throttle_pi: N" VALUE 0x0 /* @ECU_P+24 */ RL_FLOAT64 0 CM_IDENTICAL -1e+12 1e+12 /end CHARACTERISTIC
/begin CHARACTERISTIC ECU_P.throttle_pi_lower "throttle_pi: lower" VALUE 0x0 /* @ECU_P+32 */ RL_FLOAT64 0 CM_IDENTICAL -1e+12 1e+12 /end CHARACTERISTIC
/begin CHARACTERISTIC ECU_P.throttle_pi_upper "throttle_pi: upper" VALUE 0x0 /* @ECU_P+40 */ RL_FLOAT64 0 CM_IDENTICAL -1e+12 1e+12 /end CHARACTERISTIC
/begin CHARACTERISTIC ECU_P.throttle_pi_Kb "throttle_pi: Kb" VALUE 0x0 /* @ECU_P+48 */ RL_FLOAT64 0 CM_IDENTICAL -1e+12 1e+12 /end CHARACTERISTIC
/begin MEASUREMENT ECU_B.target_deg "target_deg" FLOAT64_IEEE CM_IDENTICAL 0 0 -1e12 1e12 ECU_ADDRESS 0x0 /* @ECU_B+0 */ /end MEASUREMENT
/begin MEASUREMENT ECU_B.tps_deg "tps_deg" FLOAT64_IEEE CM_IDENTICAL 0 0 -1e12 1e12 ECU_ADDRESS 0x0 /* @ECU_B+8 */ /end MEASUREMENT
/begin MEASUREMENT ECU_B.tps_sample "tps_sample" FLOAT64_IEEE CM_IDENTICAL 0 0 -1e12 1e12 ECU_ADDRESS 0x0 /* @ECU_B+16 */ /end MEASUREMENT
/begin MEASUREMENT ECU_B.error "error" FLOAT64_IEEE CM_IDENTICAL 0 0 -1e12 1e12 ECU_ADDRESS 0x0 /* @ECU_B+24 */ /end MEASUREMENT
/begin MEASUREMENT ECU_B.throttle_pi "throttle_pi" FLOAT64_IEEE CM_IDENTICAL 0 0 -1e12 1e12 ECU_ADDRESS 0x0 /* @ECU_B+32 */ /end MEASUREMENT
/end MODULE
/end PROJECT
